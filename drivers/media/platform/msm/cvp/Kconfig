## drivers/media/platform/msm/cvp/Kconfig
```kconfig
# SPDX-License-Identifier: GPL-2.0-only
#
# CVP CORE
#

menuconfig MSM_CVP
	tristate "MSM CVP driver"
	depends on MSM_GLOBAL_SYNX
	help
	  Enable support of MSM CVP driver for
	  Qualcomm Technologies, Inc.
```
